## meta-rcar-common/conf/layer.conf
```bitbake
# We have a conf and classes directory, add to BBPATH
BBPATH .= ":${LAYERDIR}"

# We have recipes-* directories, add to BBFILES
BBFILES += "${LAYERDIR}/recipes-*/*/*.bb \
            ${LAYERDIR}/recipes-*/*/*.bbappend"

BBFILE_COLLECTIONS += "meta-rcar-common-dev-utils"
BBFILE_PATTERN_meta-rcar-common-dev-utils = "^${LAYERDIR}/"
BBFILE_PRIORITY_meta-rcar-common-dev-utils = "7"

#LAYERDEPENDS_meta-rcar-common-dev-utils = "rcar"
LAYERSERIES_COMPAT_meta-rcar-common-dev-utils = "dunfell"
```

## meta-rcar-gen3/conf/layer.conf
```bitbake
# We have a conf and classes directory, add to BBPATH
BBPATH .= ":${LAYERDIR}"

# We have recipes-* directories, add to BBFILES
BBFILES += "${LAYERDIR}/recipes-*/*/*.bb \
            ${LAYERDIR}/recipes-*/*/*.bbappend"

BBFILE_COLLECTIONS += "meta-rcar-gen3-dev-utils"
BBFILE_PATTERN_meta-rcar-gen3-dev-utils = "^${LAYERDIR}/"
BBFILE_PRIORITY_meta-rcar-gen3-dev-utils = "7"

LAYERDEPENDS_meta-rcar-gen3-dev-utils = "rcar-gen3"
LAYERSERIES_COMPAT_meta-rcar-gen3-dev-utils = "dunfell kirkstone"
```
